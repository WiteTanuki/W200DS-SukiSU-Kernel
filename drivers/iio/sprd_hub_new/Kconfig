## drivers/iio/sprd_hub_new/Kconfig
```kconfig
#
# SPRD Sensor Hub New drivers configuration
#

menu "Spreadtrum Sensor Hub new"

config SPRD_SENSOR_HUB_NEW
	tristate "Spreadtrum Sensor Hub New"
	select IIO_BUFFER
	select IIO_KFIFO_BUF
	select IIO_TRIGGER
	depends on SPRD_SIPC
	depends on SPRD_SYSTIMER
	help
	  Support Sensor hub new Feature
	  Provide power saving solution for integrating and
	  processing sensor data.

	  Say Y here to build support for sensor hub new.
	  To compile this driver as a module, choose M here

config VENDOR_ZTE_UNDER_PANEL_LIGHT
	bool "Zte Under Panel Light"
	help
	  Zte Support Under Panel Light Feature to
	  transform lcd backlight and fps to sensorhub

config ZTE_SENSOR_CALI_SUPPORT
	bool "Zte sensor cali algo support"
	help
	  Zte sensor cali algo Feature

endmenu
```

## drivers/nfc/st54j/Kconfig
```kconfig
config NFC_ST21NFCJ
	tristate "NFC_ST21NFCJ Controller"
	---help---
	  You'll have to say Y if your computer contains an NFC_ST21NFCJ I2C device that
	  you want to use under Linux.

	  You can say N here if you don't have any NFC_ST21NFCJ I2C connected to your computer.

config NFC_ST54J
	tristate "NFC_ST54J Controller"
	---help---
	  You'll have to say Y if your computer contains an NFC_ST54J I2C device that
	  you want to use under Linux.

	  You can say N here if you don't have any NFC_ST54J I2C connected to your computer.
```

## drivers/soc/sprd/fsa4480/Kconfig
```kconfig
config SPRD_FSA4480_I2C
	bool "Fairchild FSA4480 chip with I2C"
	select REGMAP_I2C
	depends on I2C
	help
	  Support for the Fairchild FSA4480 IC switch chip controlled
	  using I2C. This driver provides common support
	  for accessing the device, switching between USB and Audio
	  modes, changing orientation.
```

## sound/soc/codecs/aw87xxx_87391_87565/Kconfig
```kconfig
config ZTE_SND_SOC_AW87XXX_AW87381_AW87565
	tristate "SoC Audio for awinic AW87XXX Smart K PA"
	depends on I2C
	help
	  This option enables support for AW87XXX Smart K PA.
config ZTE_SND_SOC_AW87XXX_DOUBLE
	tristate "SoC Audio for awinic AW87XXX Smart K PA ZTE_SND_SOC_AW87XXX_DOUBLE"
	depends on I2C
	help
	  This option enables support for AW87XXX Smart K PA ZTE_SND_SOC_AW87XXX_DOUBLE.

config ZTE_SND_SOC_AW87XXX_2IN1
	tristate "SoC Audio for awinic AW87XXX Smart K PA ZTE_SND_SOC_AW87XXX_2IN1"
	depends on I2C
	help
	  This option enables support for AW87XXX Smart K PA ZTE_SND_SOC_AW87XXX_2IN1.
```

## sound/soc/codecs/aw883xx_new/Kconfig
```kconfig
config ZTE_AW883XX_SMART_PA_NEW
    tristate "SoC Audio for awinic aw883xx series"
    depends on I2C
    help
      This option enables support for aw883xx series Smart PA.
```
