&spi1 {
	status = "okay";
	#address-cells = <1>;
	#size-cells = <0>;
	/delete-node/ touchpanel@0;
	zte-ts@0 {
		compatible = "focaltech,fts", "himax,hxcommon", "chipone-tddi";
		reg = <0>;
		spi-max-frequency = <9600000>;
		focaltech,reset-gpio = <&ap_gpio 14 0x0000>;
		focaltech,irq-gpio =  <&eic_async 16 0x2008>; /* IRQF_ONESHOT | IRQF_TRIGGER_LOW */
		focaltech,display-coords = <0 0 1079 2407>;
		focaltech,max-touch-number = <10>;
		himax,panel-coords = <0 1079 0 2407>;
		himax,display-coords = <0 1080 0 2408>;
		himax,irq-gpio = <&eic_async 16 0x2008>;
		himax,rst-gpio = <&ap_gpio 14 0x0000>;
		report_type = <1>;
		chipone,irq-gpio = <&eic_async 16 0x2008>; /* IRQF_ONESHOT | IRQF_TRIGGER_LOW */
 		chipone,rst-gpio = <&ap_gpio 14 0x0000>;
 		chipone,x-res = <1079>;
 		chipone,y-res = <2407>;
 	};
};
