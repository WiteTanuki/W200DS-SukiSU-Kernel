&spi1 {
	status = "okay";
	#address-cells = <1>;
	#size-cells = <0>;
	/delete-node/ touchpanel@0;
	touch_spi@0 {
		compatible = "axs15205,axs15205_touch";
		status = "okay";
		reg = <0>;
		spi-max-frequency = <6000000>;

		touch,reset-gpio =  <&ap_gpio 14 0x0000>;
		touch,irq-gpio = <&eic_async 16 0x2008>;
	};
};

/{
	zte_tp:zte_tp {
		compatible = "zte_tp";
		zte,tp_algo;
		zte,tp_long_press;
		zte,tp_long_press_timer = <800>;
		zte,tp_long_press_left_v = <12>;
		zte,tp_long_press_right_v = <12>;
		zte,tp_long_press_left_h = <16>; /*camera */
		zte,tp_long_press_right_h = <12>; /*charger */
		zte,tp_edge_click_suppression_pixel = <2>;
	};
};
