/*
 * this file is ued to change sprd dtsi which can't be changed by overlay
 * such as /delete-node/ /delete-property/ and alises
 */

#include "touchscreen_pine.dtsi"
#include "zte_charger_pine.dtsi"
#include "zte_audio_pine.dtsi"
#include "zte_camera_pine.dtsi"
#include "zte_fingerprint_pine.dtsi"
#include "zte_skey.dtsi"

/{
	zcard_holder_det {
		zcard-holder-det-gpios= <&eic_sync 36 GPIO_ACTIVE_HIGH>;
	};
};

&sdio0 {
	status = "disabled";
	non-removable;
};

&reserved_memory {
	/delete-node/ dptx_hdcp@fff10000;
	/delete-node/ ise_med@bc000000;
};

