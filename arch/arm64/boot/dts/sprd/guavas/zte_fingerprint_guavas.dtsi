/ {
	fpc1020 {
		compatible = "fpc,fpc1020";
		fpc_irq = <&eic_async 29 0x00>;
		fpc_rst = <&ap_gpio 110 0x00>;
		vdd-supply = <&vddcammot1>;
		power-type = <1>;
		power-voltage = <3000000>;
	};

	goodix_fp {
		compatible = "goodix,fingerprint";
		fp-gpio-reset = <&ap_gpio 110 0x00>;
		fp-gpio-irq = <&eic_async 29 0x00>;
		vdd-supply = <&vddcammot1>;
		power-type = <1>;
		power-voltage = <3000000>;
	};

	silead_fp {
		compatible = "sil,silead_fp";
		rst-gpios = <&ap_gpio 110 0x00>;
		irq-gpios = <&eic_async 29 0x00>;
		vdd-supply = <&vddcammot1>;
		power-type = <1>;
		power-voltage = <3000000>;
	};
};
